## main/kconfig.projbuild
```kconfig
menu "Wi-Fi Configuration"

config WIFI_SSID
    string "Wi-Fi SSID"
    default "Your_SSID"
    help
        Enter the SSID of the Wi-Fi network you want to connect to.

config WIFI_PASSWORD
    string "Wi-Fi Password"
    default "Your_Password"
    help
        Enter the password of the Wi-Fi network.

endmenu
```
